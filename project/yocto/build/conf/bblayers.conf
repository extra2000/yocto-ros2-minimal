## project/yocto/build/conf/bblayers.conf
```bitbake
# POKY_BBLAYERS_CONF_VERSION is increased each time build/conf/bblayers.conf
# changes incompatibly
POKY_BBLAYERS_CONF_VERSION = "2"

ROS_OE_RELEASE_SERIES = "langdale"
ROS_DISTRO = "rolling"
ROS_BRANCH = "nobranch=1"

YOCTOROOT = "${@os.path.abspath(os.path.join("${TOPDIR}", os.pardir))}"

BBPATH = "${TOPDIR}"
BBFILES ?= ""

BBLAYERS ?= " \
  ${YOCTOROOT}/layers/poky/meta \
  ${YOCTOROOT}/layers/poky/meta-poky \
  ${YOCTOROOT}/layers/poky/meta-yocto-bsp \
  ${YOCTOROOT}/layers/meta-openembedded/meta-oe \
  ${YOCTOROOT}/layers/meta-openembedded/meta-multimedia \
  ${YOCTOROOT}/layers/meta-openembedded/meta-networking \
  ${YOCTOROOT}/layers/meta-openembedded/meta-perl \
  ${YOCTOROOT}/layers/meta-openembedded/meta-python \
  ${YOCTOROOT}/layers/meta-clang \
  ${YOCTOROOT}/layers/meta-security/meta-hardening \
  ${YOCTOROOT}/layers/meta-selinux \
  ${YOCTOROOT}/layers/meta-arm/meta-arm \
  ${YOCTOROOT}/layers/meta-arm/meta-arm-toolchain \
  ${YOCTOROOT}/layers/meta-raspberrypi \
  ${YOCTOROOT}/layers/meta-rockchip \
  ${YOCTOROOT}/layers/meta-ros/meta-ros-common \
  ${YOCTOROOT}/layers/meta-ros/meta-ros2 \
  ${YOCTOROOT}/layers/meta-ros/meta-ros2-rolling \
  ${YOCTOROOT}/layers/meta-user \
  "
```
